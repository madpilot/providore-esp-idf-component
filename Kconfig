## Kconfig
```kconfig
menu "Providore"
  config PROVIDORE_SERVER
    string "Providor server address"
    default "https://providore.local"
    help
      URL of your providore server

  config SECURED_SHARED_KEY
    bool "Store Shared key securely"
    help
      Burn the shared private key into eFuse for extra security (Requires ESP32-S2) 
endmenu
```
